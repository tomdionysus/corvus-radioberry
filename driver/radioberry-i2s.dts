// SPDX-License-Identifier: GPL-2.0-or-later
/*
 * RadioBerry on a Raspberry Pi 4 with the gateware-v2 receive image:
 * receive over I2S into the BCM2711's PCM block. Applied after the
 * radioberry overlay, in a [pi4] section of config.txt:
 *
 *   dtoverlay=radioberry
 *   [pi4]
 *   dtoverlay=radioberry-i2s
 *   [all]
 *
 * It gives the radioberry device the PCM block by phandle and puts GPIO 18
 * to 21 in their PCM function (bit clock, frame sync, data in, data out).
 * The PCM node itself stays disabled, so the stock I2S driver never binds
 * it and no sound card appears; the radioberry driver programs the block
 * and its RX DMA channel itself. Without this overlay a Pi 4 uses the
 * CPU-clocked transport and the PIO image as before.
 */
/dts-v1/;
/plugin/;

/ {
	compatible = "brcm,bcm2711";

	fragment@0 {
		target = <&gpio>;
		__overlay__ {
			rb_pcm_pins: rb_pcm_pins {
				brcm,pins = <18 19 20 21>;
				brcm,function = <4>; /* alt0: PCM */
				brcm,pull = <0 0 0 0>;
			};
		};
	};

	fragment@1 {
		target-path = "/soc/spi@7e204000/radioberry@0";
		__overlay__ {
			radioberry,pcm = <&i2s>;
			pinctrl-names = "default";
			pinctrl-0 = <&rb_pcm_pins>;
		};
	};
};
